## build/conf/local.conf
```bitbake
DESCRIPTION="image minimal for Raspberry Pi 5"
MACHINE ?= "raspberrypi5"
DISTRO ?= "poky"
IMAGE_FSTYPES = "wic.gz"
TCLIBC = "musl"  
LICENSE_FLAGS_ACCEPTED += "synaptics-killswitch commercial"
# We will use the ipk package format for our image
PACKAGE_CLASSES = "package_ipk"

ENABLE_UART = "1"

# Use systemd for faster boot (optimized init system with parallel service startup)
# 'networking' enables ifupdown so /etc/network/interfaces is executed at boot
DISTRO_FEATURES:append = " usrmerge wifi networking systemd"
VIRTUAL-RUNTIME_init_manager = "systemd"

# Libcamera sera configuré via la bbappend dans meta-football
# pour forcer le pipeline RPi sur toutes les machines Raspberry Pi


INSANE_SKIP:pn-libcamera = "license-checksum"
DISALLOW_EMPTY_LIC_FILES_CHKSUM = "0"

# Force RPi PiSP pipeline for libcamera
PACKAGECONFIG:append:pn-libcamera = " raspberrypi"
EXTRA_OEMESON:append:pn-libcamera = " -Dpipelines=rpi/pisp -Dipas=rpi/pisp"

# Enable WiFi autoconnect via systemd service
IMAGE_INSTALL:append = " wifi-busybox"
<
```

## layers/meta-football/conf/layer.conf
```bitbake
# We have a conf and classes directory, add to BBPATH
BBPATH .= ":${LAYERDIR}"

# We have recipes-* directories, add to BBFILES
BBFILES += "${LAYERDIR}/recipes-*/*/*.bb \
            ${LAYERDIR}/recipes-*/*/*.bbappend"

BBFILE_COLLECTIONS += "meta-football"
BBFILE_PATTERN_meta-football = "^${LAYERDIR}/"
BBFILE_PRIORITY_meta-football = "6"

LAYERDEPENDS_meta-football = "core"
LAYERSERIES_COMPAT_meta-football = "scarthgap"
```
