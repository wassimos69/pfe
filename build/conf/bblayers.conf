## build/conf/bblayers.conf
```bitbake
# POKY_BBLAYERS_CONF_VERSION is increased each time build/conf/bblayers.conf
# changes incompatibly
POKY_BBLAYERS_CONF_VERSION = "2"

BBPATH = "${TOPDIR}"
BBFILES ?= ""

BBLAYERS ?= " \
  /home/wassim/Bureau/yocto/pfe/layers/poky/meta \
  /home/wassim/Bureau/yocto/pfe/layers/poky/meta-poky \
  /home/wassim/Bureau/yocto/pfe/layers/poky/meta-yocto-bsp \
  /home/wassim/Bureau/yocto/pfe/layers/meta-football \
  /home/wassim/Bureau/yocto/pfe/layers/meta-raspberrypi \
  /home/wassim/Bureau/yocto/pfe/layers/meta-openembedded/meta-oe \
  /home/wassim/Bureau/yocto/pfe/layers/meta-openembedded/meta-python \
  /home/wassim/Bureau/yocto/pfe/layers/meta-openembedded/meta-multimedia \
  /home/wassim/Bureau/yocto/pfe/layers/meta-hailo/meta-hailo-libhailort \
  /home/wassim/Bureau/yocto/pfe/layers/meta-hailo/meta-hailo-accelerator \
  "
```
